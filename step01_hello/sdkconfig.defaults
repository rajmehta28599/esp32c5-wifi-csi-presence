## step02_wifi_sta/main/Kconfig.projbuild
```kconfig
menu "ESP32-C5 CSI Project Configuration"

    config CSI_WIFI_SSID
        string "WiFi SSID"
        default "MyRouter"
        help
            Name of your 2.4 GHz WiFi network. The ESP32-C5 must join a
            2.4 GHz network for this project - CSI geometry is kept stable
            by locking the radio to 2.4 GHz / 20 MHz.

    config CSI_WIFI_PASSWORD
        string "WiFi Password"
        default "mypassword"
        help
            WPA2 password of your WiFi network. Leave empty for an open network.

    config CSI_WIFI_MAX_RETRY
        int "Maximum connection retries"
        default 10
        help
            How many times to retry association before giving up and rebooting.

endmenu
```

## step04_csi_geometry/main/Kconfig.projbuild
```kconfig
menu "ESP32-C5 CSI Project Configuration"

    config CSI_WIFI_SSID
        string "WiFi SSID"
        default "MyRouter"
        help
            Name of your 2.4 GHz WiFi network. The ESP32-C5 must join a
            2.4 GHz network for this project - CSI geometry is kept stable
            by locking the radio to 2.4 GHz / 20 MHz.

    config CSI_WIFI_PASSWORD
        string "WiFi Password"
        default "mypassword"
        help
            WPA2 password of your WiFi network. Leave empty for an open network.

    config CSI_WIFI_MAX_RETRY
        int "Maximum connection retries"
        default 10
        help
            How many times to retry association before giving up and rebooting.

    config CSI_PING_INTERVAL_MS
        int "Ping interval in milliseconds"
        default 20
        range 5 1000
        help
            The ESP32-C5 only gets CSI from packets it RECEIVES. To keep a
            steady stream of receptions we ping the router continuously.
            20 ms = 50 packets/second, which is plenty for detecting a human
            walking. Lower = more responsive but more airtime.

endmenu
```

## step05_amplitude/main/Kconfig.projbuild
```kconfig
menu "ESP32-C5 CSI Project Configuration"

    config CSI_WIFI_SSID
        string "WiFi SSID"
        default "MyRouter"
        help
            Name of your 2.4 GHz WiFi network.

    config CSI_WIFI_PASSWORD
        string "WiFi Password"
        default "mypassword"
        help
            WPA2 password of your WiFi network. Leave empty for an open network.

    config CSI_WIFI_MAX_RETRY
        int "Maximum connection retries"
        default 10

    config CSI_PING_INTERVAL_MS
        int "Ping interval in milliseconds"
        default 20
        range 5 1000
        help
            20 ms = 50 CSI packets/second.

    config CSI_LLTF_ONLY
        bool "Capture L-LTF only (one fixed CSI shape)"
        default n
        help
            Decision rule - use the output of Step 04:

              * If Step 04's histogram showed ONE shape with more than ~90%
                of the packets, leave this OFF. The auto-lock picks that
                dominant shape and you get the richest CSI available.

              * If Step 04's histogram FRAGMENTED across three or more shapes
                (mixed 11g / HT / HE traffic from your router), turn this ON.
                Only the legacy long training field is captured, which is
                present in every single packet regardless of PHY, so every
                packet then yields exactly the same number of subcarriers.
                You lose some resolution but gain a rock-steady stream.

    config CSI_CSV_DECIMATE
        int "Print 1 CSV line out of every N packets"
        default 5
        range 1 100
        help
            At 50 packets/s a full CSV dump of 64 subcarriers can swamp the
            serial console. 5 means ~10 lines/s, which plots nicely and still
            leaves the console readable.

    config CSI_LOCK_PACKETS
        int "Packets to observe before locking the CSI shape"
        default 200
        range 20 2000
        help
            The firmware watches this many packets, finds the most common
            CSI length, then accepts only that length from then on. Mixing
            lengths in one statistic is the classic way to get a detector
            that never triggers.

endmenu
```

## step06_baseline/main/Kconfig.projbuild
```kconfig
menu "ESP32-C5 CSI Project Configuration"

    config CSI_WIFI_SSID
        string "WiFi SSID"
        default "MyRouter"

    config CSI_WIFI_PASSWORD
        string "WiFi Password"
        default "mypassword"

    config CSI_WIFI_MAX_RETRY
        int "Maximum connection retries"
        default 10

    config CSI_PING_INTERVAL_MS
        int "Ping interval in milliseconds"
        default 20
        range 5 1000

    config CSI_LLTF_ONLY
        bool "Capture L-LTF only (one fixed CSI shape)"
        default n
        help
            Turn ON if Step 04's histogram fragmented across three or more
            shapes. Leave OFF if one shape held more than ~90%.

    config CSI_LOCK_PACKETS
        int "Packets to observe before locking the CSI shape"
        default 200
        range 20 2000

    config CSI_CAL_WARMUP_S
        int "Calibration warm-up seconds"
        default 5
        range 2 60
        help
            Time to let the slow/fast averages settle before measuring
            anything. Nothing is recorded during warm-up.

    config CSI_CAL_PHASE_A_S
        int "Calibration phase A seconds (per-subcarrier noise)"
        default 15
        range 5 120
        help
            Phase A measures how noisy each individual subcarrier is when
            the room is empty. That noise level is what every later
            measurement gets divided by.

    config CSI_CAL_PHASE_B_S
        int "Calibration phase B seconds (metric noise floor)"
        default 15
        range 5 120
        help
            Phase B measures how much the two detector metrics wobble in an
            empty room. The detection thresholds are set from this, so the
            system tunes itself to YOUR room instead of a magic number.

    config CSI_SELECT_MIN_AMP
        int "Subcarrier selection: minimum mean amplitude (x100 of median)"
        default 20
        range 1 100
        help
            Null and guard subcarriers sit near zero and carry no
            information - including them only adds noise. Any subcarrier
            whose mean normalised amplitude is below this (as a percentage
            of the packet median, so 20 = 0.20) is discarded.

endmenu
```

## step07_presence/main/Kconfig.projbuild
```kconfig
menu "ESP32-C5 CSI Project Configuration"

    config CSI_WIFI_SSID
        string "WiFi SSID"
        default "MyRouter"

    config CSI_WIFI_PASSWORD
        string "WiFi Password"
        default "mypassword"

    config CSI_WIFI_MAX_RETRY
        int "Maximum connection retries"
        default 10

    config CSI_PING_INTERVAL_MS
        int "Ping interval in milliseconds"
        default 20
        range 5 1000

    config CSI_LLTF_ONLY
        bool "Capture L-LTF only (one fixed CSI shape)"
        default n
        help
            MUST match whatever you used in Step 06. If it does not, the
            CSI shape will differ from the stored baseline and the firmware
            will tell you to recalibrate.

    config CSI_LOCK_PACKETS
        int "Packets to observe before locking the CSI shape"
        default 200
        range 20 2000

    menu "Detection tuning"

        config CSI_MOTION_SIGMA_X100
            int "Motion trigger, in hundredths of a standard deviation"
            default 500
            range 100 5000
            help
                500 means "fire when the motion metric M is 5.00 standard
                deviations above its empty-room mean". Raise it if you get
                false alarms, lower it if walking is missed.
                This is the PRIMARY detector.

        config CSI_MOTION_RELEASE_X100
            int "Motion release threshold, hundredths of a std dev"
            default 250
            range 50 5000
            help
                Hysteresis. Once triggered, motion stays flagged until M
                falls below this LOWER threshold. Prevents the output
                chattering on and off around a single threshold.

        config CSI_STATIC_SIGMA_X100
            int "Static-presence trigger, hundredths of a std dev"
            default 500
            range 100 5000
            help
                Applies to the deviation metric D - "the room has settled
                into a different state". Someone standing still.

        config CSI_STATIC_SUSTAIN_MS
            int "Static presence must persist for this long (ms)"
            default 4000
            range 500 60000
            help
                D alone is not trustworthy - it also rises for slow
                environmental drift. Requiring several seconds of sustained
                deviation before asserting presence removes most of that.

        config CSI_PRESENCE_HOLD_MS
            int "Keep reporting PRESENT for this long after the last trigger"
            default 5000
            range 500 120000
            help
                A person who pauses between steps would otherwise flicker
                the output. This holds the PRESENT state open.

    endmenu

    config CSI_LED_GPIO
        int "GPIO for a presence LED (-1 to disable)"
        default -1
        range -1 48
        help
            Optional. Set to the GPIO number of a plain LED on your board to
            get a physical presence indicator. Left at -1 (disabled) because
            devkit LED pins differ between boards - check your board's
            schematic before setting it. Note that boards whose only LED is
            an addressable RGB (WS2812) type will NOT work with this simple
            on/off drive.

endmenu
```

## step08_final_human_detector/main/Kconfig.projbuild
```kconfig
menu "ESP32-C5 CSI Human Detector"

    menu "WiFi"

        config CSI_WIFI_SSID
            string "WiFi SSID (2.4 GHz)"
            default "MyRouter"

        config CSI_WIFI_PASSWORD
            string "WiFi Password"
            default "mypassword"

        config CSI_WIFI_MAX_RETRY
            int "Maximum connection retries"
            default 10

        config CSI_PING_INTERVAL_MS
            int "Ping interval in milliseconds"
            default 20
            range 5 1000
            help
                Sets the CSI sample rate. 20 ms = 50 Hz.

    endmenu

    menu "CSI capture"

        config CSI_LLTF_ONLY
            bool "Capture L-LTF only (one fixed CSI shape)"
            default n
            help
                Turn ON if Step 04's histogram fragmented across three or
                more shapes. Changing this INVALIDATES a stored baseline -
                the firmware will detect that and recalibrate itself.

        config CSI_LOCK_PACKETS
            int "Packets to observe before locking the CSI shape"
            default 200
            range 20 2000

    endmenu

    menu "Calibration"

        config CSI_FORCE_RECALIBRATE
            bool "Force recalibration on next boot"
            default n
            help
                The board-independent way to recalibrate. Turn this ON,
                flash, leave the room while it calibrates, then turn it OFF
                and flash again so it does not recalibrate on every reboot.

                (The firmware also calibrates automatically whenever no
                valid baseline is stored, so a brand-new board just works.)

        config CSI_CAL_WARMUP_S
            int "Calibration warm-up seconds"
            default 5
            range 2 60

        config CSI_CAL_PHASE_A_S
            int "Phase A seconds (per-subcarrier noise)"
            default 15
            range 5 120

        config CSI_CAL_PHASE_B_S
            int "Phase B seconds (metric noise floor)"
            default 15
            range 5 120

        config CSI_CAL_LEAVE_ROOM_S
            int "Grace period before calibration starts (seconds)"
            default 10
            range 0 120
            help
                Countdown after boot so you have time to walk out of the
                room before measurement begins.

        config CSI_SELECT_MIN_AMP
            int "Subcarrier selection: minimum mean amplitude (x100)"
            default 20
            range 1 100

    endmenu

    menu "Detection tuning"

        config CSI_MOTION_SIGMA_X100
            int "Motion trigger, hundredths of a standard deviation"
            default 500
            range 100 5000
            help
                Raise for fewer false alarms, lower for more sensitivity.
                This is the primary detector.

        config CSI_MOTION_RELEASE_X100
            int "Motion release threshold, hundredths of a std dev"
            default 250
            range 50 5000

        config CSI_STATIC_SIGMA_X100
            int "Static-presence trigger, hundredths of a std dev"
            default 500
            range 100 5000

        config CSI_STATIC_SUSTAIN_MS
            int "Static presence must persist this long (ms)"
            default 4000
            range 500 60000

        config CSI_PRESENCE_HOLD_MS
            int "Hold PRESENT this long after the last trigger (ms)"
            default 5000
            range 500 120000

    endmenu

    menu "Outputs"

        config CSI_LED_GPIO
            int "GPIO for a presence LED (-1 to disable)"
            default -1
            range -1 48
            help
                Plain on/off LED. Left disabled by default because devkit
                LED pins differ - check YOUR board's schematic first. Boards
                whose only LED is an addressable RGB (WS2812) type will not
                work with this simple drive.

        config CSI_LED_ACTIVE_LOW
            bool "Presence LED is active low"
            default n
            depends on CSI_LED_GPIO >= 0

        config CSI_BUTTON_GPIO
            int "GPIO for a recalibrate button (-1 to disable)"
            default -1
            range -1 48
            help
                Hold for 2 seconds to recalibrate. Assumed active-low with
                an internal pull-up, which is how a BOOT-style button is
                normally wired. Check your board's schematic for the pin
                number - it is not the same across devkits, which is why
                there is no default here.

        config CSI_JSON_PERIOD_MS
            int "Emit a JSON status line every N ms (0 to disable)"
            default 500
            range 0 60000
            help
                Machine-readable output for a host script, Home Assistant,
                an MQTT bridge, and so on. Lines start with 'JSON ' so they
                are easy to grep out of the log stream.

        config CSI_HUMAN_READABLE
            bool "Also print the human-readable bar graph"
            default y

    endmenu

endmenu
```

## step09_espressif_sensing/main/Kconfig.projbuild
```kconfig
menu "ESP32-C5 CSI Project Configuration"

    config CSI_WIFI_SSID
        string "WiFi SSID"
        default "MyRouter"
        help
            The 2.4 GHz network to associate with. Must be the same network
            you used for Steps 02-08, or the comparison is meaningless.

    config CSI_WIFI_PASSWORD
        string "WiFi Password"
        default "mypassword"
        help
            Password for the network above.

    config CSI_WIFI_MAX_RETRY
        int "Maximum connection retries"
        default 10
        help
            Give up and report failure after this many association attempts.

endmenu
```
